## sdkconfig.defaults
```kconfig
CONFIG_ESPTOOLPY_FLASHSIZE_16MB=y
CONFIG_ESPTOOLPY_FLASHMODE_DIO=y
CONFIG_PARTITION_TABLE_CUSTOM=y
CONFIG_PARTITION_TABLE_CUSTOM_FILENAME="partitions.csv"
CONFIG_SPIRAM=y
CONFIG_SPIRAM_MODE_OCT=y
CONFIG_SPIRAM_SPEED_80M=y
CONFIG_ESP_DEFAULT_CPU_FREQ_MHZ_240=y
CONFIG_ESP_MAIN_TASK_STACK_SIZE=6144
CONFIG_HTTPD_MAX_REQ_HDR_LEN=1024
CONFIG_MBEDTLS_CERTIFICATE_BUNDLE=y
CONFIG_MBEDTLS_EXTERNAL_MEM_ALLOC=y
CONFIG_SR_WN_WN9_HILEXIN=y
CONFIG_SR_WN_WN9_HAI1XIAO3XIANG4_TTS3=y
CONFIG_SR_WN_WN9_HIMIAOMIAO_TTS=y
CONFIG_SR_WN_WN9_NIHAOXIAOZHI_TTS=y
CONFIG_SR_WN_WN9_XIAOYAXIAOYA_TTS2=y
CONFIG_SR_WN_WN9_XIAOLUXIAOLU_TTS2=y
CONFIG_SR_WN_WN9_XIAOLONGXIAOLONG_TTS=y
CONFIG_SR_WN_WN9_XIAOBINXIAOBIN_TTS=y
CONFIG_SR_WN_WN9_XIAO3JIA1XIAO3JIA1_TTS3=y
CONFIG_SR_WN_WN9_HAI1XIAO3OU1_TTS3=y
CONFIG_SR_WN_WN9_XIAOSUROU_TTS2=y
CONFIG_SR_WN_WN9L_NI3HAO3XING1BAO3_TTS3=y
CONFIG_SR_WN_WN9_NIHAODONGDONG_TTS2=y
CONFIG_SR_WN_WN9_NIHAOXIAOAN_TTS2=y
CONFIG_SR_WN_WN9_MIAOMIAOTONGXUE_TTS=y
CONFIG_SR_WN_WN9_XIAOMEITONGXUE_TTS=y
CONFIG_SR_WN_WN10_SHUANG1ER2=y
CONFIG_SR_WN_WN10_TU2TU2NI3HAO3=y
CONFIG_SR_WN_WN10_DOU4BAO1DOU4BAO1=y
CONFIG_SR_WN_WN10_DEEPSEEK=y
```
